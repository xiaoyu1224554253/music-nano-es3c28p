## main/Kconfig.projbuild
```kconfig
menu "A2DP Example Configuration"
    config EXAMPLE_SSP_ENABLED
        bool "Secure Simple Pairing"
        depends on BT_CLASSIC_ENABLED
        default n
        help
            This enables the Secure Simple Pairing. If disable this option,
            Bluedroid will only support Legacy Pairing

    config EXAMPLE_PEER_DEVICE_NAME
        string "Target Device Name"
        default "TWS"
        help
            Use this option to set target device name to connect.

    config RUNTIME_MONITOR_ENABLE
        bool "启用运行时 CPU/内存监控"
        default y
        help
            每 5 秒在串口打印空闲内存和 CPU 空闲率。
endmenu
```

## sdkconfig.defaults
```kconfig
# ESP32-S3 (ES3C28P: N16R8 = 16MB Flash + 8MB OPI PSRAM)
CONFIG_ESPTOOLPY_FLASHMODE_QIO=y
CONFIG_ESPTOOLPY_FLASHFREQ_80M=y
CONFIG_ESPTOOLPY_FLASHSIZE_16MB=y
CONFIG_COMPILER_OPTIMIZATION_PERF=y
CONFIG_ESP_DEFAULT_CPU_FREQ_MHZ_240=y
CONFIG_ESP_MAIN_TASK_STACK_SIZE=3584

# PSRAM (OPI 80MHz)
CONFIG_SPIRAM=y
CONFIG_SPIRAM_MODE_OCT=y
CONFIG_SPIRAM_SPEED_80M=y
CONFIG_SPIRAM_MEMTEST=n
CONFIG_SPIRAM_ALLOW_BSS_SEG_EXTERNAL_MEMORY=y
CONFIG_FREERTOS_TASK_CREATE_ALLOW_EXT_MEM=y

# 蓝牙: 经典蓝牙 (BR/EDR) + A2DP Source, 关闭 BLE
CONFIG_BT_ENABLED=y
CONFIG_BT_CONTROLLER_ENABLED=y
CONFIG_BT_BLUEDROID_ENABLED=y
CONFIG_BT_CLASSIC_ENABLED=y
CONFIG_BT_A2DP_ENABLE=y
CONFIG_BT_AVRCP_ENABLED=y
CONFIG_BT_BLE_ENABLED=n
CONFIG_BT_SDP_PAD_LEN=300
CONFIG_BT_SDP_ATTR_LEN=300
CONFIG_BT_ACL_CONNECTIONS=1
CONFIG_BTDM_CTRL_MODE_BR_EDR_ONLY=y
CONFIG_BTDM_CTRL_BR_EDR_MAX_ACL_CONN=1
CONFIG_BT_ALARM_MAX_NUM=20
CONFIG_BT_BTC_TASK_STACK_SIZE=4096
CONFIG_BT_BTU_TASK_STACK_SIZE=4096
CONFIG_ESP_COEX_SW_COEXIST_ENABLE=n

# 关闭 WiFi (本项目不使用, 省 RAM)
CONFIG_ESP_WIFI_ENABLED=n
CONFIG_ESP_WIFI_NVS_ENABLED=n
CONFIG_ESP_WIFI_ENTERPRISE_SUPPORT=n

# 文件系统
CONFIG_FATFS_LFN_HEAP=y
CONFIG_FATFS_API_ENCODING_UTF_8=y

# LVGL
CONFIG_LV_CONF_SKIP=n
CONFIG_LV_BUILD_EXAMPLES=n

# 启动加速 / 运行时统计
CONFIG_BOOTLOADER_SKIP_VALIDATE_IN_DEEP_SLEEP=y
CONFIG_FREERTOS_GENERATE_RUN_TIME_STATS=y
CONFIG_FREERTOS_VTASKLIST_INCLUDE_COREID=y
```
